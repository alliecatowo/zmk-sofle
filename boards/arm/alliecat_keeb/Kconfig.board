## boards/arm/alliecat_keeb/Kconfig.board
```kconfig
#
# Copyright (c) 2024 The ZMK Contributors
# SPDX-License-Identifier: MIT
#

config BOARD_ALLIECAT_KEEB_LEFT
    bool "alliecat_keeb left"
    depends on SOC_NRF52840_QIAA

config BOARD_ALLIECAT_KEEB_RIGHT
    bool "alliecat_keeb right"
    depends on SOC_NRF52840_QIAA
```

## boards/arm/alliecat_sofle/Kconfig.board
```kconfig
#
# Copyright (c) 2024 The ZMK Contributors
# SPDX-License-Identifier: MIT
#

config BOARD_ALLIECAT_SOFLE_LEFT
    bool "alliecat_sofle left"
    depends on SOC_NRF52840_QIAA

config BOARD_ALLIECAT_SOFLE_RIGHT
    bool "alliecat_sofle right"
    depends on SOC_NRF52840_QIAA

config BOARD_ALLIECAT_SOFLE_DONGLE
    bool "alliecat_sofle dongle"
    depends on SOC_NRF52840_QIAA
```

## boards/shields/alliecat_dongle/Kconfig.defconfig
```kconfig
# SPDX-License-Identifier: MIT

if SHIELD_ALLIECAT_DONGLE

config SHIELD_ALLIECAT_DONGLE
    def_bool y

endif
```

## boards/shields/alliecat_dongle/Kconfig.shield
```kconfig
# SPDX-License-Identifier: MIT

config SHIELD_ALLIECAT_DONGLE
    def_bool $(shields_list_contains,alliecat_dongle)
```

## boards/shields/alliecat_keeb_peripheral/Kconfig.shield
```kconfig
config SHIELD_ALLIECAT_KEEB_PERIPHERAL
    def_bool $(shields_list_contains,alliecat_keeb_peripheral)
```

## boards/shields/alliecat_sofle/Kconfig.shield
```kconfig
# Copyright (c) 2020 The ZMK Contributors
# SPDX-License-Identifier: MIT

config SHIELD_ALLIECAT_SOFLE_CENTRAL_DONGLE
    def_bool $(shields_list_contains,alliecat_sofle_central_dongle)

config SHIELD_ALLIECAT_SOFLE_PERIPHERAL_LEFT
    def_bool $(shields_list_contains,alliecat_sofle_peripheral_left)

config SHIELD_ALLIECAT_SOFLE_PERIPHERAL_RIGHT
    def_bool $(shields_list_contains,alliecat_sofle_peripheral_right)
```

## config/west.yml
```yaml
manifest:
  remotes:
    - name: zmkfirmware
      url-base: https://github.com/zmkfirmware
      # Additional modules containing boards/shields/custom code can be listed here as well.
      # See:
      # - https://zmk.dev/docs/features/modules
      # - https://docs.zephyrproject.org/3.5.0/develop/west/manifest.html#projects
    # - name: gpeye
    #   url-base: https://github.com/GPeye
    - name: englmaxi
      url-base: https://github.com/englmaxi
    - name: mctechnology17
      url-base: https://github.com/mctechnology17

  projects:
    - name: zmk
      remote: zmkfirmware
      revision: main
      import: app/west.yml
    - name: zmk-nice-oled
      remote: mctechnology17
      revision: main
    - name: zmk-dongle-display
      remote: englmaxi
      revision: main
  self:
    path: config
```
