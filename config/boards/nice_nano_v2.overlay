/*
 * Copyright (c) 2024 The ZMK Contributors
 *
 * SPDX-License-Identifier: MIT
 */

nice_view_spi: &spi0 {
    compatible = "nordic,nrf-spim";
    status = "okay";
    cs-gpios = <&gpio0 6 GPIO_ACTIVE_HIGH>;
};
